/*
 * Fireplace
November 09, 2017

Copyright (C) 2017 Jan Schümann
All rights reserved.

This library is free software; you can redistribute it and/or
modify it under the terms of the GNU Lesser General Public
License as published by the Free Software Foundation; either
version 2.1 of the License, or (at your option) any later version.
*/

#include "Arduboy2.h"
#include <avr/pgmspace.h>


#define FIRE_X 50
#define FIRE_Y 50

Arduboy2 arduboy;


const uint8_t PROGMEM fireplace[] = {
0x7f,0x3f,0xa0,0xc3,0x6c,0x3a,0x9d,0x4d,0xa7,0xd3,0xe9,0x74,0x7a,0xbe,0x74,0x76,
0x9b,0x8d,0x3e,0xbd,0xdd,0x6e,0xb7,0x8a,0x2b,0x1d,0xad,0x92,0xca,0xae,0xb7,0xb1,
0xc5,0x96,0x4e,0xa7,0x95,0xac,0xf4,0x36,0xbd,0x54,0x32,0xb6,0x78,0xd3,0xe9,0xed,
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0x98,0x2c,0xd7,0xb9,0xda,0x6e,0x95,0x43,0x11
};

void setup() {
  
  arduboy.begin();

  arduboy.setFrameRate(15);
  
  arduboy.initRandomSeed();
  
  arduboy.clear();
  arduboy.drawCompressed(0,0,fireplace);
  
}

unsigned char lasthighest = FIRE_Y;

void loop() {
  if (!(arduboy.nextFrame()))
    return;
        
   for (int x = FIRE_X; x < FIRE_X+26; x++) {
       
        if(!(random(2))) arduboy.drawPixel(x, FIRE_Y, 1); else arduboy.drawPixel(x, FIRE_Y, 0);
    }
  
    unsigned char nowhighest = FIRE_Y;
    for (int y = FIRE_Y - 1; y >= lasthighest - 1; y--){
        for (int x = FIRE_X; x < FIRE_X+26; x++){
            
            if (! (random(7))) {
                arduboy.drawPixel(x, y, 0);
            } else {
                int v = arduboy.getPixel(x - 1, y + 1);
                v += arduboy.getPixel(x + 1, y + 1);
                v += arduboy.getPixel(x, y + 1);
                

                if (v && (random(v))){
                    arduboy.drawPixel(x, y, 1);
                    if( y < nowhighest && y > 0) nowhighest = y;
                }
                else if(!v)
                    arduboy.drawPixel(x, y, 0);

            }
        }
    }
    lasthighest = nowhighest - 2;

  arduboy.display();
}

